/*
******************************************************************************
**
** @file        : LinkerScript.ld
**
** @author      : Auto-generated by STM32CubeIDE
**
** @brief       : Linker script for STM32H503CBTx Device from STM32H5 series
**                      128KBytes FLASH
**                      32KBytes RAM
**
**                Set heap size, stack size and stack location according
**                to application requirements.
**
**                Set memory bank area and size if external memory is used
**
**  Target      : STMicroelectronics STM32
**
**  Distribution: The file is distributed as is, without any warranty
**                of any kind.
**
******************************************************************************
** @attention
**
** Copyright (c) 2025 STMicroelectronics.
** All rights reserved.
**
** This software is licensed under terms that can be found in the LICENSE file
** in the root directory of this software component.
** If no LICENSE file comes with this software, it is provided AS-IS.
**
******************************************************************************
*/

/* Entry Point */
ENTRY(BL_Reset_Handler)

/* Highest address of the user mode stack */
_estack = ORIGIN(RAM) + LENGTH(RAM); /* end of "RAM" Ram type memory */

_Min_Heap_Size = 0x200; /* required amount of heap */
_Min_Stack_Size = 0x400; /* required amount of stack */

/* Memories definition */
MEMORY
{
	/* Firmware + accesories */
  FLASH (rx)      		: ORIGIN = 0x08000000, LENGTH = 120K
  FLASH_PRGADR (rx)		: ORIGIN = 0x0801E000, LENGTH = 256
  FLASH_PRGJUMP (rx)	: ORIGIN = 0x0801E100, LENGTH = 256
  FLASH_PRGCRC (rx)		: ORIGIN = 0x0801E200, LENGTH = 256

	/* Setup */
  FLASH_PATCH (rx)		: ORIGIN = 0x08040000, LENGTH = 8K
  FLASH_UNIT (rx)		: ORIGIN = 0x08042000, LENGTH = 8K
  FLASH_WHRS (rx)		: ORIGIN = 0x08044000, LENGTH = 8K
  FLASH_DIMMERS (rx)	: ORIGIN = 0x08046000, LENGTH = 8K
  FLASH_RDM_UID (rx)	: ORIGIN = 0x08048000, LENGTH = 8K
  
  	/* Bootloader */
  FLASH_BOOT (rx)		: ORIGIN = 0x08060000, LENGTH = 64K
  FLASH_BOOT_FIX (rx)	: ORIGIN = 0x08070000, LENGTH = 256  
  FLASH_BOOT_FNC (rx)	: ORIGIN = 0x08070100, LENGTH = 256
  FLASH_BOOT_VER (rx)	: ORIGIN = 0x08070200, LENGTH = 256
  
  	/* RAM */
  RAM_FLASH_BUF (xrw)	: ORIGIN = 0x20000000, LENGTH = 8K
  RAM (xrw)       		: ORIGIN = 0x20002000, LENGTH = 24K
}

/* Define output sections */
SECTIONS
{
  /* The startup code goes first into FLASH */
  .isr_vector (READONLY) :
  {
    . = ALIGN(4);
    KEEP(*(.isr_vector)) /* Startup code */
    . = ALIGN(4);
  } >FLASH

  /* Special section for starting program */
  .flash_jump_to_program (READONLY) :
  {
	_flash_program_jump = .;
	*(.flash_jump_to_prg*);
  } > FLASH_PRGJUMP

  /* All files starting with dc4_Boot are in this section */
  .flash_BootLdr (READONLY) :
  {
    . = ALIGN(4);
    *dc48_Boot*.o (.text .text*)
    . = ALIGN(4);
    *dc48_Boot*.o (.rodata .rodata*)
  	*(.flash_BootLdr*);
  } > FLASH_BOOT

  /* The program code and other data goes into FLASH */
  .text (READONLY) :
  {
    . = ALIGN(4);
    *(.text)           /* .text sections (code) */
    *(.text*)          /* .text* sections (code) */
    *(.glue_7)         /* glue arm to thumb code */
    *(.glue_7t)        /* glue thumb to arm code */
    *(.eh_frame)

    KEEP (*(.init))
    KEEP (*(.fini))

    . = ALIGN(4);
    _etext = .;        /* define a global symbols at end of code */
  } >FLASH

  /* Constant data goes into FLASH */
  .rodata (READONLY) :
  {
    . = ALIGN(4);
    *(.rodata)         /* .rodata sections (constants, strings, etc.) */
    *(.rodata*)        /* .rodata* sections (constants, strings, etc.) */
    . = ALIGN(4);
  } >FLASH

   .ARM.extab (READONLY)  : { *(.ARM.extab* .gnu.linkonce.armextab.*) } >FLASH
    .ARM (READONLY) : {
    __exidx_start = .;
      *(.ARM.exidx*)
      __exidx_end = .;
    } >FLASH

/*-------------------------------------------------------------------------
  Nove pridane sekce FLASH.
  -------------------------------------------------------------------------
*/    
  .flash_patch (READONLY) :
  {
  	KEEP (*(.flash_Patch*));
  } > FLASH_PATCH
  
  .flash_unit (READONLY) :
  {
  	_flash_unit_setts = .;
  	*(.flash_Unit*);
  } >FLASH_UNIT

  .flash_whrs (READONLY) :
  {
  	_flash_whrs = .;
  	*(.flash_Whrs*);
  } > FLASH_WHRS

  .flash_dimmers (READONLY) :
  {
  	KEEP (*(.flash_Dimmers*));
  } > FLASH_DIMMERS

  .flash_rdm (READONLY) :
  {
  	_flash_rdm = .;
  	*(.flash_Rdm*);
  } >FLASH_RDM_UID

  .flash_prgcrc (READONLY) :
  {
  	*(.flash_PrgCrc*);
  } > FLASH_PRGCRC

  .flash_bootver (READONLY) :
  {
  	KEEP(*(.flash_BootVer*))
  } > FLASH_BOOT_VER

  .flash_bootfnc (READONLY) :
  {
  	*(.flash_BootFnc*);
  } > FLASH_BOOT_FNC

  .flash_boot_fix (READONLY) :
  {
  	*(.flash_BootFix*);
  } > FLASH_BOOT_FIX
  
/*-------------------------------------------------------------------------*/

  .preinit_array (READONLY)     :
  {
    PROVIDE_HIDDEN (__preinit_array_start = .);
    KEEP (*(.preinit_array*))
    PROVIDE_HIDDEN (__preinit_array_end = .);
  } >FLASH
  .init_array (READONLY) :
  {
    PROVIDE_HIDDEN (__init_array_start = .);
    KEEP (*(SORT(.init_array.*)))
    KEEP (*(.init_array*))
    PROVIDE_HIDDEN (__init_array_end = .);
  } >FLASH
  .fini_array (READONLY) :
  {
    PROVIDE_HIDDEN (__fini_array_start = .);
    KEEP (*(SORT(.fini_array.*)))
    KEEP (*(.fini_array*))
    PROVIDE_HIDDEN (__fini_array_end = .);
  } >FLASH


    .RAM_flash_write_buf (NOLOAD) :
  {
  	*(.ram_flash_write_buf*);
  } > RAM_FLASH_BUF
  

  /* used by the startup to initialize data */
  _sidata = LOADADDR(.data);

  /* Initialized data sections goes into RAM, load LMA copy after code */
  .data : 
  {
    . = ALIGN(4);
    _sdata = .;        /* create a global symbol at data start */
    *(.data)           /* .data sections */
    *(.data*)          /* .data* sections */

    . = ALIGN(4);
    _edata = .;        /* define a global symbol at data end */
  } >RAM AT> FLASH
  
  /* Uninitialized data section */
  . = ALIGN(4);
  .bss :
  {
    /* This is used by the startup in order to initialize the .bss secion */
    _sbss = .;         /* define a global symbol at bss start */
    __bss_start__ = _sbss;
    *(.bss)
    *(.bss*)
    *(COMMON)

    . = ALIGN(4);
    _ebss = .;         /* define a global symbol at bss end */
    __bss_end__ = _ebss;
  } >RAM

  /* User_heap_stack section, used to check that there is enough RAM left */
  ._user_heap_stack :
  {
    . = ALIGN(4);
    PROVIDE ( end = . );
    PROVIDE ( _end = . );
    . = . + _Min_Heap_Size;
    . = . + _Min_Stack_Size;
    . = ALIGN(4);
  } >RAM

  /* Remove information from the standard libraries */
  /DISCARD/ :
  {
    libc.a ( * )
    libm.a ( * )
    libgcc.a ( * )
  }

  .ARM.attributes 0 : { *(.ARM.attributes) }
  
  _firmware_begin = LOADADDR(.isr_vector);
  _image_start = LOADADDR(.text);
  _image_end = LOADADDR(.data);
  _image_size = _image_end - _image_start;
  _firmware_size = _image_end - _firmware_begin;
  _bootldr_func = LOADADDR(.flash_bootfnc);
  _program_reset_handler = 0;

  .flash_prgadr (READONLY) :
  {
    _prg_addresses = .;
  	LONG(_firmware_begin)
  	LONG(_firmware_size)
  	LONG(_image_start)
  	LONG(_image_end)
  	LONG(_image_size)
  	LONG(_bootldr_func)
  	LONG(_flash_unit_setts)
  	LONG(Reset_Handler)
  	LONG(BL_Reset_Handler)
	. = . + 28;					/* add 7 LONG so that 16 LONG is total */
  	KEEP(*(.flash_PrgAdr*));
  } > FLASH_PRGADR
}
